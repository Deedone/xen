## automation/renesas-scripts/docker/manifest/west.yml
```yaml
# The west manifest file for upstream Zephyr

manifest:

  projects:
    - name: zephyr
      url: https://github.com/zephyrproject-rtos/zephyr.git
      revision: "v4.4-branch"
      path: zephyr
      west-commands: scripts/west-commands.yml
    - name: zephyr-xenlib
      url: https://github.com/xen-troops/zephyr-xenlib.git
      revision: "main"
      path: zephyr-xenlib

  self:
    path: manifest
```

## xen/arch/arm/configs/rel_arm64_defconfig
```kconfig
CONFIG_NR_CPUS=32
# CONFIG_ARM_EFI is not set
# CONFIG_GICV2 is not set
CONFIG_GICV3_ESPI=y
CONFIG_HAS_ITS=y
# CONFIG_VGICV2 is not set
# CONFIG_HWDOM_VUART is not set
CONFIG_FFA=y
# CONFIG_PARTIAL_EMULATION is not set
CONFIG_ARM_SCI_NONE=y
CONFIG_PCI_PASSTHROUGH=y
CONFIG_NO_PLAT=y
CONFIG_STATIC_MEMORY=y
CONFIG_STATIC_SHM=y
CONFIG_STACK_PROTECTOR=y
# CONFIG_HYPFS_CONFIG is not set
# CONFIG_EFI_SET_VIRTUAL_ADDRESS_MAP is not set
# CONFIG_XSM_SILO is not set
# CONFIG_SCHED_CREDIT is not set
CONFIG_SCHED_RTDS=y
CONFIG_SCHED_NULL=y
CONFIG_BOOT_TIME_CPUPOOLS=y
CONFIG_LLC_COLORING=y
CONFIG_SYSTEM_SUSPEND=y
# CONFIG_HAS_NS16550 is not set
# CONFIG_HAS_CADENCE_UART is not set
# CONFIG_HAS_LINFLEX is not set
# CONFIG_HAS_IMX_LPUART is not set
# CONFIG_HAS_MVEBU is not set
# CONFIG_HAS_MESON is not set
# CONFIG_HAS_OMAP is not set
# CONFIG_ARM_SMMU is not set
CONFIG_ARM_SMMU_V3=y
CONFIG_EXPERT=y
```

## xen/arch/arm/pci/Kconfig
```kconfig
menu "PCI host controllers"
	depends on HAS_PCI

config PCI_HOST_GENERIC
	bool "Generic ECAM PCI host controller"
	default n

config PCI_HOST_ZYNQMP
	bool "Xilinx ZynqMP PCI host controller"
	default n

config PCI_HOST_VERSAL
	bool "Xilinx Versal CPM PCI host controller"
	default n

config PCI_HOST_RCAR
	bool "Renesas R-Car PCI host controller"
	default n
	select PCI_HOST_DESIGNWARE
	help
	  Support for the R-Car PCIe controller.

config PCI_HOST_DESIGNWARE
	bool

endmenu
```

## xen/drivers/pci/Kconfig
```kconfig
config HAS_PCI
	bool

config HAS_PCI_MSI
	bool
	depends on HAS_PCI

config PCI_REBAR
    bool "Enable resizable bar support for PCI devices"
    depends on HAS_PCI
    default n
```
